## config/west.yml
```yaml
manifest:
    remotes:
        - name: zmkfirmware
          url-base: https://github.com/zmkfirmware
        - name: m165437
          url-base: https://github.com/M165437
        - name: gpeye
          url-base: https://github.com/GPeye
        - name: arman639
          url-base: https://github.com/arman639
        - name: englmaxi
          url-base: https://github.com/englmaxi
    projects:
        - name: zmk
          remote: zmkfirmware
          revision: v0.3
          import: app/west.yml
        - name: nice-view-gem
          remote: m165437
          revision: v0.3.0

        - name: prospector-zmk-module
          remote: arman639
          revision: 935ce92e1fff8cc1dc7b15354f8270af7cab0c07 # branch: change_spi2
        - name: zmk-dongle-display
          remote: englmaxi
          revision: v0.3
    self:
        path: config
```
